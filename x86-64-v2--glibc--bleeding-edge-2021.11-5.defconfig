## x86-64-v2--glibc--bleeding-edge-2021.11-5.defconfig
```kconfig
BR2_x86_64=y
BR2_x86_x86_64_v2=y
BR2_HOST_DIR="/builds/bootlin/toolchains-builder/build/x86-64-v2--glibc--bleeding-edge-2021.11-5"
BR2_TOOLCHAIN_BUILDROOT_GLIBC=y
BR2_KERNEL_HEADERS_5_10=y
BR2_BINUTILS_VERSION_2_38_X=y
BR2_TOOLCHAIN_BUILDROOT_CXX=y
BR2_TOOLCHAIN_BUILDROOT_FORTRAN=y
BR2_PACKAGE_HOST_GDB=y
BR2_PACKAGE_HOST_GDB_TUI=y
BR2_PACKAGE_HOST_GDB_PYTHON3=y
BR2_GDB_VERSION_11=y
BR2_INIT_NONE=y
BR2_SYSTEM_BIN_SH_NONE=y
# BR2_PACKAGE_BUSYBOX is not set
BR2_PACKAGE_GDB=y
# BR2_TARGET_ROOTFS_TAR is not set
BR2_GCC_VERSION_11_X=y
```
